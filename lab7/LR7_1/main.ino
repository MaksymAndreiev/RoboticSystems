#define F_CPU 16000000UL

#include <avr/io.h>

void ADC_init() {
    ADCSRA |= (1 << ADEN)                                            //Вмикаємо АЦП
              | (1 << ADPS2) | (1 << ADPS1) | (1 << ADPS0);                        //Дільник 128
    ADMUX |= (1 << REFS0);                                        //Внутрішній ДОН
    ADMUX |= (1 << MUX0) | (1 << MUX2);                                //вхід ADC5(PC5);
}

uint16_t ADC_read() {                                            //Функція для читання та перетворення АЦП
    ADCSRA |= (1 << ADSC);                                        //Початок перетворення
    while (ADCSRA & (1 << ADSC));                                //Доки перетворення не завершено
    return ADC;
}

int main(void) {
    DDRB |= (1 << DDB5);                                            //Встановлюю пін PB5=D13 на ВИХІД
    DDRC |= (1 << DDC0);                                            //Встановлюю пін PC0=A0 на ВИХІД
    DDRD |= (1 << DDD2);                                            //Встановлюю пін PD2=D2 на ВИХІД
    TCCR1A |= (1 << WGM11) | (1 << WGM10);                            //3 режим - PWM Phase Correct, 10-bit
    TCCR1B |= (1 << CS11) | (1 << CS10);                            //дільник 64
    TCCR1A |= (1 << COM1A1);                                        //Неінвертований ШИМ на каналі А
    ADC_init();
    while (1) {
        OCR1A = ADC_read();                                     //Зчитую перетворене значення і записую в регістр порівняння OCR1A
        if (OCR1A >= 0 && OCR1A < 256) {                         //Якщо значення в діапазоні 0-255
            PORTB &= ~(1 << PORTB5);                              //
            PORTC &= ~(1 << PORTC0);                              //Вимикаємо всі 3 світлодіоди
            PORTD &= ~(1 << PORTD2);                              //
        } else if (OCR1A >= 256 && OCR1A < 512) {                //Інакше якщо значення в діапазоні 256-511
            PORTB |= (1 << PORTB5);                               //
            PORTC &= ~(1 << PORTC0);                              //Вмикаємо 1 та вимикаємо 2 і 3 світлодіоди
            PORTD &= ~(1 << PORTD2);                              //
        } else if (OCR1A >= 512 && OCR1A < 768) {                //Інакше якщо значення в діапазоні 512-767
            PORTB |= (1 << PORTB5);                               //
            PORTC |= (1 << PORTC0);                               //Вмикаємо 1 та 2 світлодіоди і вимикаємо 3
            PORTD &= ~(1 << PORTD2);                              //
        } else {                                                //Інакше значення в діапазоні 768-1023
            PORTB |= (1 << PORTB5);                               //
            PORTC |= (1 << PORTC0);                               //Вмикаємо всі 3 світлодіоди
            PORTD |= (1 << PORTD2);                               //
        }
    }
}