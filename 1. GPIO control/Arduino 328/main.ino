#define F_CPU 16000000UL // Частота - 16MHz

#include <avr/io.h>        // Бібліотека вводу/виводу

int main(void) {
    // дві кнопки
    DDRF &= ~(1 << DDF4);    // ВХІД на A4(PF4)
    DDRH &= ~(1 << DDH6);    // ВХІД на D9(PH6)
    // три світодіода
    DDRE |= (1 << DDE4);    // вихід на D2(PE4)
    DDRG |= (1 << DDG5);    // вихід на D4(PG5)
    DDRB |= (1 << DDB4);    // вихід на D10(PB4)


    while (1) {
        if ((PINF & (1 << PINF4)) && (PINH & (1 << PINH6))) {
            //не натиснуті обидві кнопки
            PORTE &= ~(1 << PORTE4);        // вимикаємо світодіод 1
            PORTG &= ~(1 << PORTG5);        // вимикаємо світодіод 2
            PORTB &= ~(1 << PORTB4);        // вимикаємо світодіод 3
        } else if (PINH & (1 << PINH6)) {
            // не натиснута друга кнопка
            PORTE |= (1 << PORTE4);        // вмикаємо свідодіод 1
            PORTG &= ~(1 << PORTG5);        // вимикаємо світодіод 2
            PORTB &= ~(1 << PORTB4);        // вимикаємо світодіод 3
        } else if (PINF & (1 << PINF4)) {
            // не натиснута перша кнопка
            PORTE &= ~(1 << PORTE4);        // вимикаємо світодіод 1
            PORTG |= (1 << PORTG5);        // вмикаємо свідодіод 2
            PORTB &= ~(1 << PORTB4);        // вимикаємо світодіод 3
        } else {
            // натиснуті обидві кнопки
            PORTE &= ~(1 << PORTE4);        // вимикаємо світодіод 1
            PORTG &= ~(1 << PORTG5);        // вимикаємо світодіод 2
            PORTB |= (1 << PORTB4);        // вмикаємо свідодіод 3
        }
    }
}
