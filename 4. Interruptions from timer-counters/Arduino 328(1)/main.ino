#define F_CPU 16000000UL            // вкажемо компілятору частоту

#include <avr/io.h>                //Бібліотека вводу/виводу AVR
#include <util/delay.h>
#include <avr/interrupt.h>            // Бібліотека імен переривань

volatile uint8_t counter = 0;            // лічільник
volatile bool flag = 1;                // 1 - ВИСОКИЙ, 0 - НИЗЬКИЙ

int main(void) {
    DDRC |= (1 << DDC5);                // пін А5 на вихід
    PORTC |= (1 << PORTC5);            // ініціалізуємо
    TCCR0B |= (1 << CS00);            // дільник 1
    TIMSK0 |= (1 << TOIE0);            // дозволяємо переривання по переповненню
    sei();                            // Дозволяемо глобальні переривання

    while (1) {}
}

ISR(TIMER0_OVF_vect){                // обробник переривань за вектором переривань
        // "Переповнення таймера/лічильника T0"
        counter++;                        // рахуєм переривання
        if (flag){                        // якщо рахуємо високий рівень сигналу
            if (counter == 6) {                // якщо переривання було викликано 6 раз (100мкс)
                PORTC &= ~(1 << PORTC5);        // інвертуємо сигнал, встановлюємо 0
                counter = 0;                // лічильник онуляємо
                flag = 0;                    // тепер відслідковуємо низький рівень
            }
        }else{                            // якщо рахуємо низький рівень сигналу
            if (counter == 9) {            // якщо переривання було викликано 9 раз (150мкс)
                PORTC |= (1 << PORTC5);        // інвертуємо сигнал, встановлюємо 1
                counter = 0;                // лічильник онуляємо
                flag = 1;                    // тепер відслідковуємо високий рівень
            }
        }
}
