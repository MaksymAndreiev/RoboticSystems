#define F_CPU 16000000UL

#include <avr/io.h>
#include <util/delay.h>

void ADC_init() {
    ADCSRA |= (1 << ADEN)                                        //Вмикаємо АЦП
              | (1 << ADPS2) | (1 << ADPS1) | (1 << ADPS0)                    //Дільник 128
              | (1 << ADATE);                                            //Вмикаємо режим автоматичного запуску АЦП
    ADMUX |= (1 << REFS0)                                        //Вмикаємо внутрішній ДОН
             | (1 << MUX1)                                                //Вхід ADC2(PF2);
             | (1 << ADLAR);                                            //Ліве вирівнювання, зчитуємо тільки ADCH
    ADCSRB = 0;                                                //Безперервне перетворювання
    ADCSRA |= (1 << ADSC);                                    //Розпочинаємо перетворювання
}

int main(void) {
    DDRB |= (1 << DDB7);                                        //Налаштовуємо пін PB7=D13=OC0A на ВИХІД
    DDRG |= (1 << DDG5);                                        //Налаштовуємо пін PG5=D4=OC0B на ВИХІД
    TCCR0A |= (1 << WGM20);                                    //режим Phase Correct #1 (TOP=255)
    TCCR0B |= (1 << CS01) | (1 << CS00);                        //Дільник 64
    TCCR0A |= (1 << COM0A1) | (1 << COM0B1);                    //Неінвертований ШИМ
    ADC_init();
    while (1) {
        if (ADCSRA & (1 << ADIF)) {                            //Якщо перетворення завершено
            ADCSRA |= (1 << ADIF);                            //Скидаємо флаг
            if (ADCH <
                128) {                                //Якщо значення старшого біта регістру ADC в діапазоні 0-127
                OCR0A = ADCH *
                        2;                        //Подвоюємо значення, щоб досягти в кінці максимального значення
                OCR0B = 0;                                //Другий світлодіод вимкнений
            } else {                                        //Інакше значення в діапазоні 128-255
                OCR0B = (ADCH - 128) * 2;                //Вмикаємо світлодіод і збільшуємо поступово його яскравість
                OCR0A = 255;                                //Перший світлодіод на повну яскравість
            }
        }
    }
}